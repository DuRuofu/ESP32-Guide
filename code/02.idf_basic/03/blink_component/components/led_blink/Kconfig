## code/02.idf_basic/03/blink_component/components/led_blink/Kconfig
```kconfig
menu "点灯配置"

    choice BLINK_LED
        prompt "LED模式"
        default BLINK_LED_GPIO
        config BLINK_LED_GPIO
            bool "GPIO"
        config BLINK_LED_STRIP
            bool "LED strip"
    endchoice

    config BLINK_GPIO
        int "LED引脚号"
        default 2

    config BLINK_PERIOD
        int "LED周期"
        default 1000

endmenu
```
